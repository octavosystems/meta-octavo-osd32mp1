## conf/layer.conf
```bitbake
# We have a conf and classes directory, add to BBPATH
BBPATH .= ":${LAYERDIR}"

# We have recipes-* directories, add to BBFILES
BBFILES += "${LAYERDIR}/recipes-*/*/*.bb \
            ${LAYERDIR}/recipes-*/*/*.bbappend"

BBFILE_COLLECTIONS += "meta-octavo-osd32mp1"
BBFILE_PATTERN_meta-octavo-osd32mp1 := "^${LAYERDIR}/"
BBFILE_PRIORITY_meta-octavo-osd32mp1 = "8"

# Layer dependency
LAYERDEPENDS_meta-octavo-osd32mp1 = "stm-st-stm32mp core openembedded-layer meta-python"
LAYERSERIES_COMPAT_meta-octavo-osd32mp1 = "scarthgap"
LAYERVERSION_meta-octavo-osd32mp1 = "1"

EULA_FILE_ST:stm32mpcommon = "${LAYERDIR}/conf/eula/${MACHINE}"
EULA_FILE_ST_MD5SUM:stm32mpcommon = "e2d447e74916dc0995960110b775aea0"

# OpenSTLinux compatibility version
ST_OSTL_COMPATIBILITY_VERSION_stm-st-stm32mp = "6.2"
```
